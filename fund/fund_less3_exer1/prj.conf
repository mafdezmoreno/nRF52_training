## prj.conf
```kconfig
# empty because the console drivers needed by printk() 
# are enabled by default by the board configuration
```

## src/main.c
```c
#include <zephyr/kernel.h>
#include <zephyr/sys/printk.h>

void main(void)
{
    while (1)
    {
        printk("Hello World!\n\r");
        k_msleep(1000);
    }
}
```
