## CMakeLists.txt
```
cmake_minimum_required(VERSION 3.20.0)
find_package(Zephyr REQUIRED HINTS $ENV{ZEPHYR_BASE})

project(hello_world)

target_sources_ifdef(CONFIG_FUNCTIONS app PRIVATE src/functions.c)
target_sources(app PRIVATE src/main.c)
```

## Kconfig
```
source "Kconfig.zephyr"

config FUNCTIONS
	bool "Enable my function"
	default n
```

## prj.conf
```kconfig
CONFIG_FUNCTIONS=y
```

## src/main.c
```c
#include <zephyr/kernel.h>
#include <zephyr/sys/printk.h>
#ifdef CONFIG_FUNCTIONS
#include "functions.h"
#endif
void main(void)
{
    while (1)
    {
#ifdef CONFIG_FUNCTIONS
        int a = 3, b = 4;
        printk("The sum of %d and %d is %d\n\r", a, b, sum(a, b));
#else
        printk("MYFUNCTION not enabled\r\n");
        return;
#endif
        k_msleep(1000);
    }
}
```

## src/functions.c
```c
#include "functions.h"

int sum(int a, int b)
{
    return a + b;
}
```

## src/functions.h
```c
#ifndef FUNCTIONS_H
#define FUNCTIONS_H

int sum(int a, int b);

#endif
```
